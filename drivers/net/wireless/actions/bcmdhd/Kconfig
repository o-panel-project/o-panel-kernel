## drivers/net/wireless/actions/bcmdhd/Kconfig
```kconfig
config BCMDHD
	tristate "Broadcom FullMAC wireless cards support"
	---help---
	  This module adds support for wireless adapters based on
	  Broadcom FullMAC chipset.

config BCMDHD_FW_PATH
	depends on BCMDHD
	string "Firmware path"
	default "/lib/firmware/wifi/fw_bcm40183b2_ag.bin"
	---help---
	  Path to the firmware file.

config BCMDHD_NVRAM_PATH
	depends on BCMDHD
	string "NVRAM path"
	default "/lib/firmware/wifi/nvram_ap6330.txt"
	---help---
	  Path to the calibration file.

config BCMDHD_WEXT
	bool "Enable WEXT support"
	depends on BCMDHD && CFG80211 = n
	select WIRELESS_EXT
	select WEXT_PRIV
	help
	  Enables WEXT support

choice
	prompt "Enable Chip Interface"
	depends on BCMDHD
	---help---
		Enable Chip Interface.
config BCMDHD_SDIO
		bool "SDIO bus interface support"
		depends on BCMDHD && MMC
config BCMDHD_PCIE
		bool "PCIe bus interface support"
		depends on BCMDHD && PCI
endchoice
```
